#include <FastSPI_LED2.h>
#include <LedMatrix.h>
#define NUM_LEDS 90
#define LENGTH 18
#define STRIPS 5
#define DATA_PIN A3

CLedMatrix LedMatrix;
char* msg = "eff";
int msglen, index;
CRGB color = CRGB(255, 0, 0);
CRGB blank = CRGB(0,0,0);

byte font [38][8] = {
  { 0x2, 0x5, 0x5, 0x5, 0x2}, // 0
  { 0x2, 0x6, 0x2, 0x2, 0x7},
  { 0x6, 0x1, 0x2, 0x4, 0x7},
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  {0x00,0x00,0x00,0x00,0x00}, // space
  {(0x7c>>2),(0x44>>2),(0x44>>2),(0x7c>>2),(0x44>>2)}, // a
  {(0x7c>>2),(0x44>>2),(0x78>>2),(0x44>>2),(0x7c>>2)},
  {(0x7c>>2),(0x40>>2),(0x40>>2),(0x40>>2),(0x7c>>2)},
  {(0x78>>2),(0x44>>2),(0x44>>2),(0x44>>2),(0x78>>2)},
  {(0x7c>>2),(0x40>>2),(0x78>>2),(0x40>>2),(0x7c>>2)},
  {(0x7c>>2),(0x40>>2),(0x70>>2),(0x40>>2),(0x40>>2)},
  {(0x7c>>2),(0x40>>2),(0x4c>>2),(0x44>>2),(0x7c>>2)},
  {(0x44>>2),(0x44>>2),(0x7c>>2),(0x44>>2),(0x44>>2)},
  {(0x7c>>2),(0x10>>2),(0x10>>2),(0x10>>2),(0x7c>>2)},
  {(0x0c>>2),(0x04>>2),(0x04>>2),(0x44>>2),(0x7c>>2)},
  {(0x44>>2),(0x48>>2),(0x70>>2),(0x48>>2),(0x44>>2)},
  {(0x40>>2),(0x40>>2),(0x40>>2),(0x40>>2),(0x7c>>2)},
  {(0x44>>2),(0x6c>>2),(0x54>>2),(0x44>>2),(0x44>>2)},
  {(0x44>>2),(0x64>>2),(0x54>>2),(0x4c>>2),(0x44>>2)},
  {(0x38>>2),(0x44>>2),(0x44>>2),(0x44>>2),(0x38>>2)},
  {(0x78>>2),(0x44>>2),(0x78>>2),(0x40>>2),(0x40>>2)},
  {(0x7c>>2),(0x44>>2),(0x44>>2),(0x7c>>2),(0x10>>2)},
  {(0x78>>2),(0x44>>2),(0x78>>2),(0x44>>2),(0x44>>2)},
  {(0x7c>>2),(0x40>>2),(0x7c>>2),(0x04>>2),(0x7c>>2)},
  {(0x7c>>2),(0x10>>2),(0x10>>2),(0x10>>2),(0x10>>2)},
  {(0x44>>2),(0x44>>2),(0x44>>2),(0x44>>2),(0x7c>>2)},
  {(0x44>>2),(0x44>>2),(0x28>>2),(0x28>>2),(0x10>>2)},
  {(0x44>>2),(0x44>>2),(0x54>>2),(0x54>>2),(0x28>>2)},
  {(0x44>>2),(0x28>>2),(0x10>>2),(0x28>>2),(0x44>>2)},
  {(0x44>>2),(0x44>>2),(0x28>>2),(0x10>>2),(0x10>>2)},
  {(0x7c>>2),(0x08>>2),(0x10>>2),(0x20>>2),(0x7c>>2)}, // z
  {0xff,0xff,0xff,0xff,0xff}, // errr

};

void setup()  
{
  Serial.begin(9600);
//  LEDS.addLeds<WS2811, A3, GRB>(leds, NUM_LEDS);
  LedMatrix.init(LENGTH, STRIPS, true);
  LEDS.setBrightness(14); // SET BRIGHTNESS TO 1/2 POWER
  LedMatrix.setColor(CRGB(0,0,0));
  LEDS.show();  
  msglen = strlen(msg);
  index = msglen;
}

void set_column(int i, boolean on) {
  CRGB c = on ? color : blank;
  for (int j = 0; j < STRIPS; j++) {
    LedMatrix.set(j, i, c);
  }
}

void loop() {  
  for(int i = 0; i < msglen; i++) {  // each letter of the message
    byte * bytes = getBytes(msg[i]);    
    for (int j=0; j < 5; j++) {      // each column of the letter
      for (int k=0; k < 5; k++) {    // each row of the column
        CRGB c = bytes[k] & (1 << (4-j)) ? color : blank;
        LedMatrix.set(k, LENGTH-1, c);
      }
      LEDS.show();
      delay(200);
      scroll();
    }
    scroll(); // delimit each letter with an empty column
  }
  delay(5000);  
  LedMatrix.setColor(blank);
}

void scroll() {
  for (int i = 0; i < LENGTH-1; i++) {
    for (int j = 0; j < STRIPS; j++) {
      LedMatrix.set(j, i, LedMatrix.get(j, i+1));
    }
  }
  
  set_column(LENGTH-1, false);
}

byte* getBytes(char c) {
  if (c >= '0' && c <= '9') {
    return font[c - '0'];
  }
  
  if (c == ' ') {
    return font[10];
  }
  
  Serial.write('a');
  if (c >= (int)'a' && c <= (int)'z') {
    return font[(c - 'a') + 11];
  }
  
 return font[37]; // error
}
